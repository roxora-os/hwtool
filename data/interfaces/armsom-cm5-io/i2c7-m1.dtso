// SPDX-License-Identifier: GPL-2.0-only
// I2C7 (M1). Written by tools/gen-interfaces.py.
/dts-v1/;
/plugin/;

/ {
	compatible = "armsom,cm5-io", "rockchip,rk3576";
};

&i2c7 {
	pinctrl-names = "default";
	pinctrl-0 = <&i2c7m1_xfer>;
	status = "okay";
};
