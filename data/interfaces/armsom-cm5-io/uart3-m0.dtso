// SPDX-License-Identifier: GPL-2.0-only
// UART3 (M0). Written by tools/gen-interfaces.py.
/dts-v1/;
/plugin/;

/ {
	compatible = "armsom,cm5-io", "rockchip,rk3576";
};

&uart3 {
	pinctrl-names = "default";
	pinctrl-0 = <&uart3m0_xfer>;
	status = "okay";
};
