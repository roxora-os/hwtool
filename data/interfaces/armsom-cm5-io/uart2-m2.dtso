// SPDX-License-Identifier: GPL-2.0-only
// UART2 (M2). Written by tools/gen-interfaces.py.
/dts-v1/;
/plugin/;

/ {
	compatible = "armsom,cm5-io", "rockchip,rk3576";
};

&uart2 {
	pinctrl-names = "default";
	pinctrl-0 = <&uart2m2_xfer>;
	status = "okay";
};
