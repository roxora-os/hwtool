// SPDX-License-Identifier: GPL-2.0-only
// PWM0 channel 0 (M1). Written by tools/gen-interfaces.py.
/dts-v1/;
/plugin/;

/ {
	compatible = "radxa,rock-4d", "rockchip,rk3576";
};

&pwm0_2ch_0 {
	pinctrl-names = "default";
	pinctrl-0 = <&pwm0m1_ch0>;
	status = "okay";
};
