// SPDX-License-Identifier: GPL-2.0-only
// UART10 (M1). Written by tools/gen-interfaces.py.
/dts-v1/;
/plugin/;

/ {
	compatible = "radxa,rock-4d", "rockchip,rk3576";
};

&uart10 {
	pinctrl-names = "default";
	pinctrl-0 = <&uart10m1_xfer>;
	status = "okay";
};
