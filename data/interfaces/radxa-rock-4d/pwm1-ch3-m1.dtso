// SPDX-License-Identifier: GPL-2.0-only
// PWM1 channel 3 (M1). Written by tools/gen-interfaces.py.
/dts-v1/;
/plugin/;

/ {
	compatible = "radxa,rock-4d", "rockchip,rk3576";
};

&pwm1_6ch_3 {
	pinctrl-names = "default";
	pinctrl-0 = <&pwm1m1_ch3>;
	status = "okay";
};
