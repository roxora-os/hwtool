// SPDX-License-Identifier: GPL-2.0-only
// UART3 (M2). Written by tools/gen-interfaces.py.
/dts-v1/;
/plugin/;

/ {
	compatible = "radxa,rock-4d", "rockchip,rk3576";
};

&uart3 {
	pinctrl-names = "default";
	pinctrl-0 = <&uart3m2_xfer>;
	status = "okay";
};
