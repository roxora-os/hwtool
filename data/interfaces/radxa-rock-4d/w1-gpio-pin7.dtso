// SPDX-License-Identifier: GPL-2.0-only
// 1-Wire on pin 7 (GPIO1_C3). Written by tools/gen-interfaces.py.
/dts-v1/;
/plugin/;

/ {
	compatible = "radxa,rock-4d", "rockchip,rk3576";
};

&{/} {
	onewire {
		compatible = "w1-gpio";
		gpios = <&gpio1 19 0>;
	};
};
