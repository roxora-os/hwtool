// SPDX-License-Identifier: GPL-2.0-only
// UART7 (M0). Written by tools/gen-interfaces.py.
/dts-v1/;
/plugin/;

/ {
	compatible = "radxa,rock-4d", "rockchip,rk3576";
};

&uart7 {
	pinctrl-names = "default";
	pinctrl-0 = <&uart7m0_xfer>;
	status = "okay";
};
